## suites/platform/pmu_suite/Kconfig
```kconfig
menuconfig PLATFORM_PMU
    bool "PMU support"
    default n
    depends on !TARGET_JUNO
    depends on !TARGET_ODROID_3XU
    select COMPONENT_BC
    select COMPONENT_PERF
    select COMPONENT_PMU_ASSETS
    select COMPONENT_TESTRUNNER
    ---help---
    The primary aim of the test cases within pmu_suite is to validate PMU
    support for a big.LITTLE system.

config PLATFORM_PMU_PMU_CCI_TEST_SCN09
    bool "pmu_cci_test_scn09"
    default y
    depends on PLATFORM_PMU
    ---help---
    Test CCI PMU by running cache on little CPU and counting A7 cacheable reads
    and write evict transactions.


config PLATFORM_PMU_PMU_CCI_TEST_SCN10
    bool "pmu_cci_test_scn10"
    default y
    depends on PLATFORM_PMU
    ---help---
    Test CCI PMU by running "cache -w" on big CPUs and counting events in
    grouped mode.It checks that when specifying more events than counters, perf
    returns "<not supported>" for extra counters.


config PLATFORM_PMU_PMU_CCI_TEST_SCN11
    bool "pmu_cci_test_scn11"
    default y
    depends on PLATFORM_PMU
    ---help---
    Test CCI PMU by running "cache -w" on big CPUs and counting events in
    sampling mode. This is done by not grouping the events and specifying more
    events than counters. The testcase checks that the extrapolated value
    returned is within range of the golden run.


config PLATFORM_PMU_PMU_TEST_SCN01
    bool "pmu_test_scn01"
    default y
    depends on PLATFORM_PMU
    ---help---
    Test CPU PMUs by running the 'cycles' test program and counting
    'cpu_cycles' and 'instructions' events.


config PLATFORM_PMU_PMU_TEST_SCN02
    bool "pmu_test_scn02"
    default y
    depends on PLATFORM_PMU
    ---help---
    Test CPU PMUs by running the 'cache' test program and counting
    'cache-references' and 'cache-misses' events.


config PLATFORM_PMU_PMU_TEST_SCN03
    bool "pmu_test_scn03"
    default y
    depends on PLATFORM_PMU
    ---help---
    Test CPU PMUs by running the 'branch' test program and counting
    'branch_instructions' and 'branch_misses' events.


config PLATFORM_PMU_PMU_TEST_SCN04
    bool "pmu_test_scn04"
    default y
    depends on PLATFORM_PMU
    ---help---
    Test CPU PMUs (only on A7 cluster) by running the 'cache' test program and
    counting 'cache_references' and 'cache_misses' events.


config PLATFORM_PMU_PMU_TEST_SCN05
    bool "pmu_test_scn05"
    default y
    depends on PLATFORM_PMU
    ---help---
    Test CPU PMUs (only on A7 cluster) by running the 'cache' test program and
    making sure that the last event 'branch_misses' is not supported.


config PLATFORM_PMU_PMU_TEST_SCN06
    bool "pmu_test_scn06"
    default y
    depends on PLATFORM_PMU
    ---help---
    Test CPU PMUs (only on A15 cluster) by running the 'branch' test program
    and making sure that the last event 'icache_refill' is not supported.


config PLATFORM_PMU_PMU_TEST_SCN07
    bool "pmu_test_scn07"
    default y
    depends on PLATFORM_PMU
    ---help---
    Test CPU PMUs by running the 'branch' test program and counting kernel-mode
    'branch_instructions' and 'branch_misses' events.


config PLATFORM_PMU_PMU_TEST_SCN08
    bool "pmu_test_scn08"
    default y
    depends on PLATFORM_PMU
    ---help---
    Test CPU PMUs by running the 'branch' test program while cpu idle is
    disabled and counting 'branch_instructions' and 'branch_misses' events.
```

## suites/sched/hmp_01_checks/basic_suite/Kconfig
```kconfig
menuconfig SCHED_CHECK
    bool "Key kernel configuration options"
    default n
    select COMPONENT_FUNCTESTLIB_SH
    select COMPONENT_TESTRUNNER
    ---help---
    The primary aim of the test cases within basic_suite is to validate and
    confirm the basic integration of big.LITTLE MP patches. The intend of the test
    design was to assert the specification of key kernel configurations or
    attributes as needed by big.LITTLE MP patches.

config SCHED_CHECK_BASICCHECK
    bool "basiccheck"
    default y
    depends on SCHED_CHECK
    ---help---
    Use heavy and light load generating threads to confirm that high load
    threads go to 'fast' CPUs and low load threads go to 'slow' CPUs using the
    HMP scheduler patches


config SCHED_CHECK_FT0000
    bool "FT0000"
    default y
    depends on SCHED_CHECK
    ---help---
    Assert that the kernel has HMP support


config SCHED_CHECK_FT0001
    bool "FT0001"
    default y
    depends on SCHED_CHECK
    ---help---
    Assert that the scheduler has a CPU-level domain covering all CPUs


config SCHED_CHECK_FT0002
    bool "FT0002"
    default y
    depends on SCHED_CHECK
    ---help---
    Assert that load balancing is turned off on the scheduler's CPU-level sched
    domain


config SCHED_CHECK_FT0003
    bool "FT0003"
    default y
    depends on SCHED_CHECK
    ---help---
    Assert that the scheduler has a package level (MC) domain covering the
    reported siblings for each CPU


config SCHED_CHECK_FT0004
    bool "FT0004"
    default y
    depends on SCHED_CHECK
    ---help---
    Assert that the scheduler has load balancing turned on at the package level
    (MC) domains


config SCHED_CHECK_FT0007
    bool "FT0007"
    default y
    depends on SCHED_CHECK
    ---help---
    Assert that the test framework's calculation of 'fast' CPUs are all A15s


config SCHED_CHECK_FT0008
    bool "FT0008"
    default y
    depends on SCHED_CHECK
    ---help---
    Assert that all CPUs in the package domain for 'fast' CPUs are A15s


config SCHED_CHECK_FT0011
    bool "FT0011"
    default y
    depends on SCHED_CHECK
    ---help---
    Assert that the test framework's calculation of slow CPUs contains only A7
    cores


config SCHED_CHECK_FT0012
    bool "FT0012"
    default y
    depends on SCHED_CHECK
    ---help---
    Assert that all little CPUs are in a sched domain with only other little
    CPUs


config SCHED_CHECK_FT0013
    bool "FT0013"
    default y
    depends on SCHED_CHECK
    ---help---
    Assert that the scheduler no longer prints fast/slow CPUs during boot
```

## suites/sched/hmp_01_checks/irqs_suite/Kconfig
```kconfig
menuconfig SCHED_IRQS
    bool "IRQs configuration"
    default n
    select COMPONENT_FUNCTESTLIB_SH
    select COMPONENT_TESTRUNNER
    ---help---
    The primary aim of the test cases within irq_suite is to validate and
    confirm the configuration of the default affinity mask.  For energy
    efficiency, on a big.LITTLE system, the IRQs are expected to be routed as
    much as possible to LITTLE cores.

    It could happens that some IRQ routines are registered at run-time, this
    happens for example in case of modules loading.  In case these routins does
    not requires a specific IRQ line, the default affinity mask is used to
    configure their affinity.

    This test checks the default affinity mask to ensure that big CPUs are not
    included.

config SCHED_IRQS_00_DEFAULT_AFFINITY
    bool "00_default_affinity"
    default y
    depends on SCHED_IRQS
    ---help---
    Assert that the default affinity of each IRQ is pinned on LITTLE CPUs.


config SCHED_IRQS_01_IRQS_ON_BIG
    bool "01_irqs_on_big"
    default y
    depends on SCHED_IRQS
    ---help---
    Report all the IRQs which are pinned on CPUs of the big cluster.
```

## suites/sched/hmp_01_checks/thresholds_suite/Kconfig
```kconfig
menuconfig SCHED_THRESHOLDS
    bool "HMP thresholds tuning checks"
    default n
    select COMPONENT_TESTRUNNER
    ---help---
    The primary aim of the test cases within basic_suite is to validate
    the settings of migration thresholds.


config SCHED_THRESHOLDS_00_BASIC
    bool "00_basic"
    default y
    depends on SCHED_THRESHOLDS
    ---help---
    Check for simple and common thresholds misconfiguration.
```

## suites/sched/hmp_02_basic_features/core_suite/Kconfig
```kconfig
menuconfig SCHED_BASIC_CORE
    bool "Basic functional behavior"
    default n
    select COMPONENT_BASICS_SH
    select COMPONENT_TESTRUNNER
    ---help---
    The primary aim of the test cases within core_suite is to validate the
    basic functional behaviour of big.LITTLE MP reference patches.

config SCHED_BASIC_CORE_CORE_TEST_SCN01_1
    bool "core_test_scn01.1"
    default y
    depends on SCHED_BASIC_CORE
    ---help---
    This starts with light task(s) on little domain however the computed load
    increases due to load pattern (being in runQ).  Hence the migration
    criteria is met it migrates to big domain.
    The task gets the CPU immediately.


config SCHED_BASIC_CORE_CORE_TEST_SCN02_1
    bool "core_test_scn02.1"
    default y
    depends on SCHED_BASIC_CORE
    ---help---
    This starts with a heavy task on big domain however the computed load
    decreases due to load pattern (being in idle). Hence the migration criteria
    is met and irrespective of the task priority it migrates to little domain.
    The task gets the CPU immediately.


config SCHED_BASIC_CORE_CORE_TEST_SCN03_1A
    bool "core_test_scn03.1a"
    default y
    depends on SCHED_BASIC_CORE
    ---help---
    This starts with a heavy task on big domain however the task priority is
    modified mid way through execution below cutoff, but no migration happens. The
    task gets the CPU immediately.


config SCHED_BASIC_CORE_CORE_TEST_SCN03_2A
    bool "core_test_scn03.2a"
    default y
    depends on SCHED_BASIC_CORE
    ---help---
    This starts with a heavy task however the task priority is modified mid way
    through execution below cutoff. Since the big domain is oversubscribed, the
    task stays on little domain


config SCHED_BASIC_CORE_CORE_TEST_SCN04_1
    bool "core_test_scn04.1"
    default y
    depends on SCHED_BASIC_CORE
    ---help---
    This starts with a heavy task on big domain without any specific CPU
    affinity defined. However the task’s CPU affinity is modified mid way
    through execution to little domain CPU forcing a migration to Little
    domain.  The task gets the CPU immediately.


config SCHED_BASIC_CORE_CORE_TEST_SCN04_2
    bool "core_test_scn04.2"
    default y
    depends on SCHED_BASIC_CORE
    ---help---
    This starts with a light task on little domain without any specific CPU
    affinity defined. However the task’s CPU affinity is modified mid way
    through execution to big domain. The task moves to the run queue.
```

## suites/sched/hmp_02_basic_features/extended_suite/Kconfig
```kconfig
menuconfig SCHED_BASIC_EXTENDED
    bool "Boundary conditions"
    default n
    select COMPONENT_BASICS_SH
    select COMPONENT_TESTRUNNER
    ---help---
    The primary aim of the test cases within extended_suite is to validate
    some of the boundary conditions related to the functional behaviour of
    big.LITTLE MP reference patches.


config SCHED_BASIC_EXTENDED_EXTD_TEST_SCN01_1
    bool "extd_test_scn01.1"
    default y
    depends on SCHED_BASIC_EXTENDED
    ---help---
    This scenario assumes the heavy task is already in big domain however its
    computed load is decreasing due to the load pattern (due to idling).  The
    task stays in big domain since the task load has not yet crossed below the
    down-threshold The runnable task gets CPU immediately.


config SCHED_BASIC_EXTENDED_EXTD_TEST_SCN01_2A
    bool "extd_test_scn01.2a"
    default y
    depends on SCHED_BASIC_EXTENDED
    ---help---
    The task starts with big domain and moves to the little since the big
    domain is oversubscribed.


config SCHED_BASIC_EXTENDED_EXTD_TEST_SCN01_4
    bool "extd_test_scn01.4"
    default y
    depends on SCHED_BASIC_EXTENDED
    ---help---
    This scenario assumes the light task is already in little domain however
    its computed load is increasing due to the load pattern (due to run queue
    residency).

    The task stays in little domain since the task load has not yet crossed
    above the up-threshold.

    The runnable task gets the CPU immediately.


config SCHED_BASIC_EXTENDED_EXTD_TEST_SCN03_1
    bool "extd_test_scn03.1"
    default y
    depends on SCHED_BASIC_EXTENDED
    ---help---
    This scenario assumes the heavy task is already in big domain however its
    computed load is decreasing due to the load pattern (due to idling).

    The task stays in big domain since the task load has not yet crossed below
    the down-threshold. The runnable task gets CPU immediately.


config SCHED_BASIC_EXTENDED_EXTD_TEST_SCN03_2A
    bool "extd_test_scn03.2a"
    default y
    depends on SCHED_BASIC_EXTENDED
    ---help---
    This scenario assumes the heavy task is already in big domain however its
    computed load is decreasing due to the load pattern (due to idling). The
    task moves to the little domain since the big domain is oversubscribed.


config SCHED_BASIC_EXTENDED_EXTD_TEST_SCN03_4
    bool "extd_test_scn03.4"
    default y
    depends on SCHED_BASIC_EXTENDED
    ---help---
    This scenario assumes the light task is already in little domain however
    its computed load is increasing due to the load pattern (due to run queue
    residency). The task stays in little domain eventhough the task load has
    reached at the down-threshold. The runnable task gets the CPU immediately.


config SCHED_BASIC_EXTENDED_EXTD_TEST_SCN04_1
    bool "extd_test_scn04.1"
    default y
    depends on SCHED_BASIC_EXTENDED
    ---help---
    This is a light task which started with Big domain due to CPU affinity and
    despite migration criteria satisfied is continuing on Big domain. The task
    gets CPU immediately.


config SCHED_BASIC_EXTENDED_EXTD_TEST_SCN04_2
    bool "extd_test_scn04.2"
    default y
    depends on SCHED_BASIC_EXTENDED
    ---help---
    This is a heavy task which started in big domain due to initial CPU
    affinity being big cores, however despite due to the load pattern (being in
    idle) and the computed task load is decreasing below the down threshold,
    the task continues on Big domain due to CPU affinity. The task gets the CPU
    immediately.
```

## suites/sched/hmp_02_basic_features/usecases_suite/Kconfig
```kconfig
menuconfig SCHED_BASIC_USECASES
    bool "Use-Cases Validation"
    default n
    select COMPONENT_RT_APP
    select COMPONENT_BASICS_SH
    select COMPONENT_FUNCTESTLIB_SH
    select COMPONENT_TESTRUNNER
    ---help---
    The primary aim of the test cases within usecases_suite is to validate
    the basic functional behaviour of the big.LITTLE MP reference patches
    considering a set of significative and representative use-cases.



config SCHED_BASIC_USECASES_00_SMALLTASKS
    bool "00_smalltasks"
    default y
    depends on SCHED_BASIC_USECASES
    ---help---
    This scenario checks that a low CPU intensity workload is running on LITTLE
    CPUs only. The worload considered is a syntetic MP3 audio decoding
    pipeline, where all the tasks of the pipeline are expected to be executed
    just on LITTLE CPUs.


config SCHED_BASIC_USECASES_01_RTTASKS
    bool "01_rttasks"
    default y
    depends on SCHED_BASIC_USECASES
    ---help---
    This scenario checks that a real-time workload is running on LITTLE CPUs
    only. The worload considered is a mix of syntetic real-time threads with
    different loads and temporal profiles. All the tasks of this workload
    mix  are expected to be executed just on LITTLE CPUs.


config SCHED_BASIC_USECASES_02_BIGTASKS
    bool "02_bigtasks"
    default y
    depends on SCHED_BASIC_USECASES
    ---help---
    This scenario checks that an high CPU intensity workload is running on big
    CPUs only. The worload considered is a set of batch tasks which number is
    one more than the number of the big CPUs. Only one task is expected to
    be running on a LITTLE CPU just for the time required to complete one of
    the other tasks.
```
