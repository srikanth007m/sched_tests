## suites/sched/hmp_03_advanced_features/loadbalance_suite/Kconfig
```kconfig
menuconfig SCHED_ADVANCED_LOADBALANCE
    bool "Load balance support across CPUs domains"
    default n
    select COMPONENT_BC
    select COMPONENT_FUNCTESTLIB_SH
    select COMPONENT_SYSBENCH
    select COMPONENT_TASKLIBRARY
    select COMPONENT_TESTRUNNER
    ---help---
    The primary aim of the test cases within loadbalance_suite is to validate
    global load balancing behaviour of the scheduler across CPU domains in a
    big.LITTLE system.

config SCHED_ADVANCED_LOADBALANCE_LB_SCN_00
    bool "lb_scn_00"
    default y
    depends on SCHED_ADVANCED_LOADBALANCE
    ---help---
    This scenario does two multi-threaded runs of sysbench: One with affinity
    set to the fast cpus, and one with default affinity (all).

    A performance improvement is expected in the second case as the scheduler
    can use the slower cpus as well.


config SCHED_ADVANCED_LOADBALANCE_LB_SCN_01
    bool "lb_scn_01"
    default y
    depends on SCHED_ADVANCED_LOADBALANCE
    ---help---
    This scenario does two simultaneous multi-threaded runs of sysbench.

    The expectation is that the scheduler will use all cpus when there is more
    load than the big cpus can handle and as the threads finishes the remaining
    threads will be migrated to the big cpus to get best possible performance.

    ASSUMPTION: number of little cpus >= number of big cpus
```

## suites/sched/hmp_03_advanced_features/scaleinvariance_suite/Kconfig
```kconfig
menuconfig SCHED_ADVANCED_SCALEINVARIANCE
    bool "Scale invariance support"
    default n
    select COMPONENT_PLATFORM_SH
    select COMPONENT_TASKSET
    select COMPONENT_TESTRUNNER
    ---help---
    The primary aim of the test cases within scaleinvariance_suite is to validate
    behaviour of scale invariance support for scheduler in a big.LITTLE system.

config SCHED_ADVANCED_SCALEINVARIANCE_SCALINV_TEST_0001
    bool "scalinv_test_0001"
    default y
    depends on SCHED_ADVANCED_SCALEINVARIANCE
    ---help---
    Check if we can turn scale invariance on and off


config SCHED_ADVANCED_SCALEINVARIANCE_SCALINV_TEST_0002
    bool "scalinv_test_0002"
    default y
    depends on SCHED_ADVANCED_SCALEINVARIANCE
    ---help---
    Check for presence of userspace governor in kernel


config SCHED_ADVANCED_SCALEINVARIANCE_SCALINV_TEST_0003
    bool "scalinv_test_0003"
    default y
    depends on SCHED_ADVANCED_SCALEINVARIANCE
    ---help---
    Without scale invariance, change the freq every 1s and check that the
    runnable ratio remains unchanged


config SCHED_ADVANCED_SCALEINVARIANCE_SCALINV_TEST_0004
    bool "scalinv_test_0004"
    default y
    depends on SCHED_ADVANCED_SCALEINVARIANCE
    ---help---
    Without invariance, check that the frequency changes at each step


config SCHED_ADVANCED_SCALEINVARIANCE_SCALINV_TEST_0005
    bool "scalinv_test_0005"
    default y
    depends on SCHED_ADVANCED_SCALEINVARIANCE
    ---help---
    With scale invariance on, check scale matches freq
```

## suites/sched/hmp_03_advanced_features/taskpacking_suite/Kconfig
```kconfig
menuconfig SCHED_ADVANCED_TASKPACKING
    bool "Small task packing feature"
    default n
    select COMPONENT_FUNCTESTLIB_SH
    select COMPONENT_TESTRUNNER
    ---help---
    The primary aim of the test cases within taskpacking_suite is to validate
    the functional behaviour of small task packing feature.

config SCHED_ADVANCED_TASKPACKING_PACK_SINGLE_CPU
    bool "pack_single_cpu"
    default y
    depends on SCHED_ADVANCED_TASKPACKING
    ---help---
    Use light load generating threads to confirm that all the light weight
    threads are packed on to a single little CPU
```

## suites/stability/non_functional_suite/Kconfig
```kconfig
menuconfig SCHED_STABILITY_NONFUNCTIONAL
    bool "HMP stability under stress scenarios"
    default n
    select COMPONENT_AFFINITY_TOOLS
    select COMPONENT_BUNCH_OF_TASKS
    select COMPONENT_PLATFORM_SH
    select COMPONENT_TESTRUNNER
    ---help---
    The primary aim of the test cases within non_functional_suite is to validate
    the HMP kernel's ability to perform in stress scenarios and to assess platform
    stability with HMP patches being active.

config SCHED_STABILITY_NONFUNCTIONAL_STABILITY_TEST_SCN03_1
    bool "stability_test_scn03.1"
    default y
    depends on SCHED_STABILITY_NONFUNCTIONAL
    ---help---
    Large task pool for HMP migration, for at least 10 hours


config SCHED_STABILITY_NONFUNCTIONAL_STABILITY_TEST_SCN04_1
    bool "stability_test_scn04.1"
    default y
    depends on SCHED_STABILITY_NONFUNCTIONAL
    ---help---
    Hot unplug cores from either domains when large pool of tasks are being active


config SCHED_STABILITY_NONFUNCTIONAL_STABILITY_TEST_SCN04_2
    bool "stability_test_scn04.2"
    default y
    depends on SCHED_STABILITY_NONFUNCTIONAL
    ---help---
    Hot unplug all big cores when large pool of tasks are being active


config SCHED_STABILITY_NONFUNCTIONAL_STABILITY_TEST_SCN05_1
    bool "stability_test_scn05.1"
    default y
    depends on SCHED_STABILITY_NONFUNCTIONAL
    ---help---
    Idling for long period


config SCHED_STABILITY_NONFUNCTIONAL_STABILITY_TEST_SCN06_1
    bool "stability_test_scn06.1"
    default y
    depends on SCHED_STABILITY_NONFUNCTIONAL
    ---help---
    Repeated entry of idle scenario


config SCHED_STABILITY_NONFUNCTIONAL_STRESS_TEST_SCN01_1
    bool "stress_test_scn01.1"
    default y
    depends on SCHED_STABILITY_NONFUNCTIONAL
    ---help---
    Large task pool for HMP migration.
```

## suites/stability/regression_suite/Kconfig
```kconfig
menuconfig REGRESSION_SUITE
    bool 'Verify regressions using GPL tests'
    default n
    select COMPONENT_REGRESSION_ASSETS
    select COMPONENT_TESTRUNNER
    ---help---
    This suite provides a collection of GPL tests colleced from the LWN mailing
    list, which are used to verify regression on scheduler performances.


config REGRESSION_SUITE_AFFINITY_NOTCHANGED
    bool "affinity_notchanged"
    default y
    depends on REGRESSION_SUITE
    ---help---
    This is the test from LWN affinity_notchanged.c


config REGRESSION_SUITE_CHEW
    bool "chew"
    default y
    depends on REGRESSION_SUITE
    ---help---
    This is the test from LWN chew.c


config REGRESSION_SUITE_CPUHOG
    bool "cpuhog"
    default y
    depends on REGRESSION_SUITE
    ---help---
    This is the test from LWN cpuhog.c


config REGRESSION_SUITE_FIFTYP
    bool "fiftyp"
    default y
    depends on REGRESSION_SUITE
    ---help---
    This is the test from LWN fiftyp.c


config REGRESSION_SUITE_HACKBENCH
    bool "hackbench"
    default y
    depends on REGRESSION_SUITE
    ---help---
    This is the test from LWN hackbench.c


config REGRESSION_SUITE_IRMAN2
    bool "irman2"
    default y
    depends on REGRESSION_SUITE
    ---help---
    This is the test from LWN irman2.c


config REGRESSION_SUITE_MAIN_PTH_STR01
    bool "main_pth_str01"
    default y
    depends on REGRESSION_SUITE
    ---help---
    This is the test from LWN main_pth_str01.c


config REGRESSION_SUITE_MAIN_PTH_STR02
    bool "main_pth_str02"
    default y
    depends on REGRESSION_SUITE
    ---help---
    This is the test from LWN main_pth_str02.c


config REGRESSION_SUITE_MAIN_PTH_STR03
    bool "main_pth_str03"
    default y
    depends on REGRESSION_SUITE
    ---help---
    This is the test from LWN main_pth_str03.c


config REGRESSION_SUITE_MIGRATE_TIME
    bool "migrate_time"
    default y
    depends on REGRESSION_SUITE
    ---help---
    This is the test from LWN migrate_time.c


config REGRESSION_SUITE_ONETEST
    bool "onetest"
    default y
    depends on REGRESSION_SUITE
    ---help---
    This is the test from LWN onetest.c


config REGRESSION_SUITE_PIPE_TEST
    bool "pipe_test"
    default y
    depends on REGRESSION_SUITE
    ---help---
    This is the test from LWN pipe_test.c


config REGRESSION_SUITE_PIPE_TEST_1M
    bool "pipe_test_1m"
    default y
    depends on REGRESSION_SUITE
    ---help---
    This is the test from LWN pipe_test_1m.c


config REGRESSION_SUITE_STARVE
    bool "starve"
    default y
    depends on REGRESSION_SUITE
    ---help---
    This is the test from LWN starve.c


config REGRESSION_SUITE_TENP
    bool "tenp"
    default y
    depends on REGRESSION_SUITE
    ---help---
    This is the test from LWN tenp.c


config REGRESSION_SUITE_TESTCASE
    bool "testcase"
    default y
    depends on REGRESSION_SUITE
    ---help---
    This is the test from LWN testcase.c


config REGRESSION_SUITE_TEST_FAILED
    bool "test_failed"
    default y
    depends on REGRESSION_SUITE
    ---help---
    This is the test from LWN test_failed.c


config REGRESSION_SUITE_TEST_SUCCESS
    bool "test_success"
    default y
    depends on REGRESSION_SUITE
    ---help---
    This is the test from LWN test_success.c


config REGRESSION_SUITE_THUD
    bool "thud"
    default y
    depends on REGRESSION_SUITE
    ---help---
    This is the test from LWN thud.c


config REGRESSION_SUITE_THUD2
    bool "thud2"
    default y
    depends on REGRESSION_SUITE
    ---help---
    This is the test from LWN thud2.c
```
