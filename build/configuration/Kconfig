## build/configuration/Kconfig
```kconfig
mainmenu "Sched Test Configuration"

config DONE
  bool
  default y

source "build/configuration/Kconfig-paths"

menu "Platform"
  source "build/platforms/Kconfig"
endmenu

menu "Suites"
  source "build/configuration/Kconfig-suites"
endmenu

menu "Components"
  source "build/configuration/Kconfig-components"
endmenu

menu "Deployment"
  source "build/deployment/Kconfig"
endmenu

menu "Results"
  source "build/configuration/Kconfig-results"
endmenu
```

## build/deployment/Kconfig
```kconfig
################################################################################
# Deployment Options

comment "Deployment Configuration"

config TARGET_DEPLOYMENT_PATH
  string "Deployment path"
  default "/data/local/schedtest"

config TARGET_WIPE
  bool "Wipe target installation folder"
  default y
  ---help---
  Wipe the target installation folder each time the test suite is
  deployed on the target.

config BACKUP_CALIBRATION_FILE
  bool "Use backup tasklibrary calibration file"
  default n
  ---help---
  Running the tasklibrary to generate a certain workload requires a
  calibration file which reports the performance points of each
  CPU corresponding to the required load.
  This file is automatically generated on the target the first time
  the tasklibrary is used. However that generation requires some time
  to complete thus impacting noticiable on the test execution.

  This option allows to:
  1. keep a local copy of the calibration file generated on a target
  2. make use of the backup copy if it is available for a certain target

  Backup calibration files are stored under:
    build/platform/<calibration_file>

config CALIBRATION_FILENAME
  string "Calibration file to use"
  default "calib.txt"
  depends on BACKUP_CALIBRATION_FILE
  ---help---
  The filename of the calibration file to use.

  This file is expected to be found in:
    build/platform/<calibration_file>

if TARGET_ANDROID
  source "build/deployment/Kconfig-android"
endif

if TARGET_LINUX
  source "build/deployment/Kconfig-linux"
endif
```

## build/platforms/Kconfig
```kconfig
################################################################################
# Target

choice
  prompt "Target Device"

  config TARGET_ANDROID
    bool "Android"
    ---help---
    Deploy and run test suite on an Android system.

  config TARGET_LINUX
    bool "Linux"
    ---help---
    Deploy and run test suite on a Linux system.

  config TARGET_NATIVE
    bool "Native"
    ---help---
    Run the test suite on the host system.

endchoice

config TARGET_PLATFORM
  string
  default "android" if TARGET_ANDROID
  default "linux"   if TARGET_LINUX
  default "native"  if TARGET_NATIVE
  default "unknown"


################################################################################
# Board Selection

source "build/platforms/Kconfig-boards"

################################################################################
# Cross-Toolchain Selection

comment "Toolchain"

config CROSS_COMPILER
  string "Cross-Compiler prefix"
  default "arm-linux-gnueabihf-"
  ---help---
  The prefix of the cross-compiler toolchain to use.

  The defined toolchain must be available in the path of the environment used to
  run the tests. By default the Linaro ARM toolchain is expected:
  http://www.linaro.org/downloads/
```

## components/affinity_tools/Kconfig
```kconfig
config COMPONENT_AFFINITY_TOOLS
	bool 'affinity_tools'
	default n
	---help---
	Deploy the affinity_tools component
```

## components/basics.sh/Kconfig
```kconfig
config COMPONENT_BASICS_SH
	bool 'basics.sh'
	default n
	select COMPONENT_FTRACE
	select COMPONENT_TRACE_CMD
	select COMPONENT_TASKLIBRARY
	select COMPONENT_AFFINITY_TOOLS
	select COMPONENT_PLATFORM_SH
	---help---
	Deploy the basics.sh component
```

## components/bunch_of_tasks/Kconfig
```kconfig
config COMPONENT_BUNCH_OF_TASKS
	bool 'bunch_of_tasks'
	default n
	---help---
	Deploy the bunch_of_tasks component
```

## components/ftrace/Kconfig
```kconfig
config COMPONENT_FTRACE
	bool 'ftrace'
	default n
	---help---
	Deploy the ftrace component
```

## components/functestlib.sh/Kconfig
```kconfig
config COMPONENT_FUNCTESTLIB_SH
	bool 'functestlib.sh'
	default n
	select COMPONENT_BC
	select COMPONENT_PLATFORM_SH
	select COMPONENT_TASKLIBRARY
	select COMPONENT_TASKSET
	---help---
	Deploy the functestlib.sh component
```

## components/hwbreakpoint_assets/Kconfig
```kconfig
config COMPONENT_HWBREAKPOINT_ASSETS
	bool 'hwbreakpoint_assets'
	default n
	---help---
	Deploy the hwbreakpoint_assets component
```

## components/perf/Kconfig
```kconfig
config COMPONENT_PERF
	bool 'perf'
	default n
	---help---
	Deploy the perf component
```

## components/platform.sh/Kconfig
```kconfig
config COMPONENT_PLATFORM_SH
	bool 'platform.sh'
	default n
	---help---
	Deploy the platform.sh component
```

## components/pmu_assets/Kconfig
```kconfig
config COMPONENT_PMU_ASSETS
	bool 'pmu_assets'
	default n
	---help---
	Deploy the pmu_assets component
```

## components/regression_assets/Kconfig
```kconfig
config COMPONENT_REGRESSION_ASSETS
	bool 'regression_assets'
	default n
	---help---
	Deploy the regression_assets component
```

## components/rt-app/Kconfig
```kconfig
config COMPONENT_RT_APP
	bool 'rt-app'
	default n
	---help---
	Deploy the rt-app component
```

## components/sysbench/Kconfig
```kconfig
config COMPONENT_SYSBENCH
	bool 'sysbench'
	default n
	---help---
	Deploy the sysbench component
```

## components/tasklibrary/Kconfig
```kconfig
config COMPONENT_TASKLIBRARY
	bool 'tasklibrary'
	default n
	---help---
	Deploy the tasklibrary component
```

## components/taskset/Kconfig
```kconfig
config COMPONENT_TASKSET
	bool 'taskset'
	default n
	---help---
	Deploy the taskset component
```

## components/testrunner/Kconfig
```kconfig
config COMPONENT_TESTRUNNER
	bool 'testrunner'
	default y
	select COMPONENT_TESTRUNNER_LAUNCHER
	---help---
	Deploy the testrunner component
```

## components/testrunner_launcher/Kconfig
```kconfig
config COMPONENT_TESTRUNNER_LAUNCHER
	bool 'testrunner_launcher'
	default y
	depends on COMPONENT_TESTRUNNER
	---help---
	Deploy the testrunner_launcher component
```

## components/trace-cmd/Kconfig
```kconfig
config COMPONENT_TRACE_CMD
	bool 'trace-cmd'
	default n
	---help---
	Deploy the trace-cmd component
```

## suites/ipa/functional_suite/Kconfig
```kconfig
menuconfig IPA_FUNCTIONAL
    bool "IPA Functional"
    depends on TARGET_JUNO
    default n
    ---help---
    IPA Functional Test Cases for basic correctness

config IPA_FUNCTIONAL_TZ_SYSFS
    bool 001_check_tz_sysfs
    default y
    depends on IPA_FUNCTIONAL
    ---help---
    Check if the thermal zone sysfs parameters are present and sane

config IPA_FUNCTIONAL_CDEVS
    bool 002_check_cdevs
    default y
    depends on IPA_FUNCTIONAL
    ---help---
    Check if the cooling devices are correctly populated

config IPA_FUNCTIONAL_CPUFREQ_COOLING
    bool 003_check_cpufreq_cooling
    default y
    depends on IPA_FUNCTIONAL
    ---help---
    Check if the cpufreq cooling devices are correctly populated

config IPA_FUNCTIONAL_DEVFREQ_COOLING
    bool 004_check_devfreq_cooling
    default y
    depends on IPA_FUNCTIONAL
    ---help---
    Check if the devfreq cooling devices are correctly populated

config IPA_FUNCTIONAL_TRIP_POINTS
    bool 005_check_trip_points
    default y
    depends on IPA_FUNCTIONAL
    ---help---
    Check if the trip points are correctly populated

config IPA_FUNCTIONAL_TZ_CDEVS
    bool 006_check_tz_cdevs
    default y
    depends on IPA_FUNCTIONAL
    ---help---
    Check if the cooling devices are bound to the thermal zone

config IPA_FUNCTIONAL_TZ_CDEV_TRIPS
    bool 007_check_tz_cdev_trips
    default y
    depends on IPA_FUNCTIONAL
    ---help---
    Check if the trip point and cdev association is as expected

config IPA_FUNCTIONAL_HIGH_CONTROL_HIGH_TRIGGER
    bool 008_high_control_high_trigger
    default y
    depends on IPA_FUNCTIONAL
    ---help---
    Check the extreme case of both the trip points being set to extemely high
    values.

config IPA_FUNCTIONAL_LOW_CONTROL_HIGH_TRIGGER
    bool 009_low_control_high_trigger
    default y
    depends on IPA_FUNCTIONAL
    ---help---
    Check the case where the second trip point is extremely high and the first
    one is extremely low.

config IPA_FUNCTIONAL_LOW_CONTROL_LOW_TRIGGER
    bool 010_low_control_low_trigger
    default y
    depends on IPA_FUNCTIONAL
    ---help---
    Check the case when both the trip points are extremely low
```

## suites/platform/hwbreakpoint_suite/Kconfig
```kconfig
menuconfig PLATFORM_HW_BREACKPOINTS
    bool "HW breackpoints"
    default n
    depends on !TARGET_JUNO
    depends on !TARGET_ODROID_3XU
    select COMPONENT_HWBREAKPOINT_ASSETS
    select COMPONENT_TASKSET
    select COMPONENT_TESTRUNNER
    ---help---
    The primary aim of the test cases within hwbreakpoint_suite is to validate
    ability of hardware breakpoints to survive power down sequences in a
    big.LITTLE system.

config PLATFORM_HW_BREACKPOINTS_HWBP_TEST_01
    bool "hwbp_test_01"
    default y
    depends on PLATFORM_HW_BREACKPOINTS
    ---help---
    Test that using hw breakpoints over powerdown is possible.
```
